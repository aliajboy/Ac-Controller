#include <Arduino.h>
#include <WiFi.h>
#include <AsyncTCP.h>
#include <ESPAsyncWebServer.h>
#include <OneWire.h>
#include <DallasTemperature.h>
#include <ArduinoOTA.h>
#include <ArduinoJson.h>

// Network credentials
const char *ssid = "X21-2.4G";
const char *password = "aliajboy1999";

// Static IP configuration
IPAddress local_IP(192, 168, 0, 100);
IPAddress gateway(192, 168, 0, 1);
IPAddress subnet(255, 255, 255, 0);

// Default Temperature Thresholds
String maxTempInput = "27.5";  // AC turns ON above this
String minTempInput = "26.0";  // AC turns OFF below this
String lastTemperature;

// AC state and manual override
bool acState = false;
// bool manualOverride = false;

// HTML web page with automatic refresh
const char index_html[] PROGMEM = R"rawliteral(
<!DOCTYPE HTML>
<html dir="rtl" lang="fa-IR">

<head>
    <title>کنترل دما و کولر</title>
    <meta name="viewport" content="width=device-width, initial-scale=1">
    <meta charset="UTF-8">
    <link href="https://cdn.jsdelivr.net/npm/bootstrap@5.3.0/dist/css/bootstrap.min.css" rel="stylesheet">
    <style>
        @font-face {
            font-family: "IRANSansWebFaNum";
            font-style: normal;
            font-weight: 400;
            src: url(data:application/octet-stream;base64,d09GMgABAAAAAHJkAA4AAAAA8PQAAHIHAAEAAAAAAAAAAAAAAAAAAAAAAAAAAAAAGoEIG6RiHIpOBmAAjz4RDAqC2DyCoSELiEwAATYCJAORFAQgBYdsB6QaGxbQJ9Dd9ishkJtVRRHQ7TYF49gKboeACnU2nx2tYOMgBMZ7utn//5+U4H+MYR9aD1BnVmu7s0QoUVVTH+MddioPJ0yptFJVTmnGeZjDdK+vS62ZNBE2Vp+p+65Gb5/R1fvSVKlKbar01hwoOgqHQuehU9kcdL++SPs05sEX0xCgYksIgUGIO9yJWziFCaIwx++uZj81vLXna5bzt7tMOzQJB6EvHsKehEh0RSQK+hlOjvqveDbmlvRW7AXBwIC71iinBGgpww8TDptTHRfcYCOCiRuvfvzbBXayCoxdxiPWiddGeELc6t9MkhZYPRHzPVf/KgLt8DC3/m3AqNgoc1QNGJEbiypgY83Y6BCUMChBRSSU0jMTZUPPC0W9qH9nX/Q/vTQIqlUt6+3ZuDhhMRrjTmEQGgxGID3a7zDOpkRJgj3707jx4sE1bfpZ99mLwkiW2cQ2qwSZzaOEtyGw2/22WjxpsNtIVouyQ8ZOUhk7DbJjv7fWvxV6PD+M9cb6N8eTNTNmUWlSPiee//M9NqioVACgyrb0FuUMqZ8PwPPVkt+f2zPT+wjRKIxFOISnEAahffpht0EHiq61ZLjOv2EZvm1fepXZtv9GTfZpM47C28jmArt74l8tRGQUsRujfoUvJmN4OvXfIbmL7oK76AKpTiqmTo2tY6cOQGd9eWC/gP19YtM23KYBHxYxT0m5fN98yK7cbWeqF458WIOA3rBN0QntW3n4PIiwOYYRdcruGiCZpqkSG9uH+/b7/RXET9dGJIvpzizmJUAiv0MONNuZWeHL9ft01tdlGFtVasNHioAijokOGgx/1+uxLe+OF3gsVdIaZ5J9EQFFDIKBIwrSez8C/NJ0n96FDdLuSUaWSSFVtAwVTcn87vv/t2lvwu9prL8jr/cc6aP2ox20g3agdwCoKMNdztN9o5HnPY09mpG9ksbelaVdH8ta5wv8c2R/Mq/s3Z84ANRhh5Ls/MjrD4ZP2d2ANwhUMZVIRZOTrgOCrqLTp2hSVVw0BGW6Nv5/c5/230whmVLuYrJVgHKFq9A9dSJnpjTvLc6Ukin+3QIpQEmqQlf5sq9wNRpI+P7/984bQCFtsUjuXxsL+yR3t97xsO33LZ3N5s/Sljb0Q9V5Qxc+TtI8b+9SN0OtLpIqTORJJM7G712555Mvsm1lJcrvX1WpM2R6ptyXx90qU1QwDiExBodxGGVO+O/XO7kzykv6r/YJBxHLYhX/t/f/7awtTdp3btNULo4NItaxskc2snFCCJnzN691amGKEUe6Uzo9DNNrf983p++77QCPGigsBwAOV2frMab5ZP1I+2u1mSpCBCfrgEPtoKjdJPeSJ0EIK1VBgGRMfiUrqESorMpvsKpBueZg5ZzIUOGYqNIxybPgV35s238KyikRyR6WHNhiseSiBYswzFHMtOYJxSs5p8XxSKvjsTHHW8btbydKOYRihqOwwithg34OGowbQnDzr50Lovph2LQgNiAMMUDAAEo1Y35MGg/ijx9m3e8XYyvhQB2j8p9wijIVAgs+FBUTF7R2yIZlt46OBStLHl0ltS4YjvJEcPAxmN0+ywdROJAj2Ueikh1ZqeCC4p+6qhiPdJmCKilkinfbI6pSjaROA4pWDppuW5Vo109K8AGmI4hPlTG1jlVfZXDEjng8nsJnrS1MUBrG4jXqpri6A7JR99nRjkA59RgvKzHTyShGPdoxjFmexTbOeRPP+Bm4uYQkInHBJSOEFKQoFakFoDs97ekNM+Mos+BPsY18yT51f8kDsB6cA+YJJzFe+BEFXzUlw0RVOeRRRiOoizHdzbHEPuq4oLihePfd+QLAEEUCKWSSC5kSaNTTTCf9jDDJPCtshckefxFXESyI4wi0ZxW04hcVU8pb3lNVLfU1TVBTRiUt4qk1dTFHX+nO2nwNEmuMSaaZDaZ9wC0gMYZSLbPaRlvtdtBRp110rVZ8x2/+Y1CLZEOeLE/Pn4nZKjydy5WoTO9UsephVruGNUsAn/dixTMma4ucbX1T4Ylu/QAZIY1oXNRDANeMmXIgjgkWgq8FtllRPAG4IlYLpnRwe/fe4MrseGf3FZ9C6EbuL93vf4PvwWqHA2q6Zx7e4Q9zRFGugiVNuXyBIk93ZZAojXiOLjHjOI852LK7vcdRLjUcNxRvcADGhKNImHEmKd0wZjJNm9whT8nQpr5fafaqnWCmf0b4pMQIO+HMz8pszd78NXEEVlkG5XiZa2XRe3YF1d+L5mOv1l0M3ZWq4d46Z96LJ3JgVnWvrRa21Y+ZrsVakwk967iv/oAaTuk6FfnS/LkzdzqJiiF2TlmgzORa+BjtEK6wZDayc+qEGVKEmvDfRv4no1GWI3UrvF2cEHudqgk0flkTCURUTwmJ3NL91O4M7bpVkPSOYUI0Bt5jiXiqxZ79sZeQja28lWgwiCYt9apHzKjVfv8yyViECsFkNKhrjIpaW1beutq9LbqSqwsniGWLwnmFfcuSaG/B3ScFKZAEVPUriGNtdJZ7dKjzHGvFEhNfkYhtXcNywZlGV45ZqqQnbQ6F0faG2ko0zV61slQezO688ZFF1UKSTvamTdzHo2oaVkHWg1ksnOdS135VrRCTGZXDbOhGnhCrWaltpR9LOU9jN0vE5pOKw2gwFboHKkTVr3uD2K2krn7NLJMviDtopjGbfYj1QZ7Y/8yJo1qnHLPWyHx/D7hjkaMKB3W9vHBRMq+CBbjz0ogxOmKad9Vi+v5NM+68PBIrxp5TZX6NTS7FxkUS1BeVB6Xy+JCsMKrmlfC1cEJIUec90+gH9VoXhTiK1YrxZaugcGx+sFK0RcnQxZz4PW6eoxBdazjgn7JjxSrLLaw0z2XI6GL8mExOiUncQhBzbcBR+oek1TvDsnG/sPTstF99sqjf01Ib99uQsBxIm1EN3nSTKnBFJFEsqmJ56udoXEXhjYxdTI3HqfrnoEb3+aYJk4pMgiPzaLupd2i009qI1kpuubHVLtE4QZOyDEZQddeeJBhfEwmuju47t0nrbs4Tq3EalsZEUeKq8NxbXgXhfO/orE9ywJpHnN2Xc6XivDQ6KYRIVo6o8+RrakJE9zdN0BTdrkL9uqoJbuiPYLn0Cxke1wEtSYKjGyR/lPj6C8YZflNH+USR0ZqyILy5yx1jaY9VHIxKeQbhruQRHSTlwrRx8YONiieuUUeX7UFFr6AL4JLpL5bKvVIK/4pUSsUk1S2B1F1s7KMl2oeuhN4lBobhYOyuSYDMwDwswSpswDbswSGcWDy34sqeWyDy4FsdR8MmIFMhHgUdmwZdcAqUgUrlZAcb0vehJYMKLncOrZvIECJ5vn7W1VMuzrv8Eh5cnz+w5qEEUH7jMLhxaO3goh7tg1v6LnS9+Epp7evQ9wO4tI1hzPIstnFez3B2H3sTz/glJBGg9ouJA5VVSUhKMs9AJh8kbRvN3mWf1O8OzGF4voLNJelgSEeehCZDCwg5JzJ3xJ+NE8zu61bvih1p8nfYmgXuGcJtw2gYAkpH80082hXHRMvvrkRfcPkvR4uMiA0PXjzRTsFYur5A425oEz+M9/DJrUqOov28kHVE2TVOrS6YW/obC/nrCI52hIuybEiiv0C50S9+CCaXv0L9V+jcau1NqHcBmnSqN0mFb90m2nQjY+TBORa9VSXWvbL39BnlR1HMxrtcmNbVvV36TxYHcmOoous4Nmuu5B0VUo0TVccH4NB0EINuAkNJhxr2tyycmTbSjbHg/s9gJY+3mRUv8Z4MYN2KLdiFAziGM7iEG7iHJ/AcXjn8rcUPLD7DN/gJfzz9H6cdR1aSO95NU69Zp34jJtPT81Zs2eOnHj0UqEQkVYlt+Nc5YnR+vMz1VmuwZrlP18Nfz4D6TuhuZ/i1uLA1k3aC0UmpaLPh/+Qe78xjpRPOEER2ZOA/5fQ5Mt+YO2aG03h+aTFRaIr9shVrbPSdlNQ1Yh7gg4xEN4VG2VOYSDUW8lHRpfDfs+lhVMYW3Any77EBlFxRHlVN7T9jY+ESEJMt/8Jqw5dt8IYFG5+TEls2zbwrRqb/Y/iPfgUoL0EApGa+hgRnWQlrbt8YwjNsSCmfzAq2aHhhmVO3eHm4Aq9jieHoAf3uCEDhI0BHz8HNw6uWiJhMnVZtOoUIhREmQqQosRIkwqGgKlSkWIkW7YaNGrNm3ZZtOz77Yo+vfJfLYBgoKFAdhecAqVOA1EmhOSCiGCTIVo6rc9WDs3ZhwFkdIGIUSCeFzAEi161wzgPUQ4txSnt4eVQII4XNAa5dn8H5XiFzD+HnsYZIyVUsVx9DxYgwODF4xCCJIelWSsmCEiIwxNAQxfAuFhZWGA5Ogg+yyCCLJF2pne9MPQlnmujCPEJZSic2Esk+ojhEKIeJ4hihHCeKU0RxL1E82MFH1IaLEMYlorg6H851rVA8TRTPEsGLRPAyUbxFJO8QwXtE8D6RfEIEt+ej+JFvoPi1RkmJk0+XjpxyyBhMiB4go7CmV97dzx7yfVwG0f+USCTxrymfA/3LacQgsv92jR7cn4sbUIAxJQRQOH8XCzZAkc31biwk96Trnk9M/KmUh6M8BoLjl852kVbd9BG4zXTEkPecP082O0gy46HiESegU6dXq34/hQUYNnxJIjgYJ7M6shNimNs6KiRnn4oLKdlcEKK1OYVUzMNHW4lJqRhkeoQq8u4qvKcw7y3G+wrw/izHQJxg04QwJGvB8V3gIyanYQq/XH7KCFwCJ0arQ7VxNqGHDxTAaaFBUHK1TcCY8/FrI5hx2dhwmcEbEZqCmp6ZnZuXX0SmXzAkIqPQoE2HEBgRoiTASZOBgKgAGVWREhWq1aNr149J3KvGzFiwZNUenv4AQgwLDB58CMSklHQMLBw8fMIyJPEJicnVa9WuU6gwkWIlwkuXJUc+EopCxUpVqtGgRZ8hw0aMmjZr0Se7A/D2N5RyEXBIJGQYGkZWTm9wk+VXGEx96D2saHGSpMiWqwxNrUategyYNGeZLghGGGt5kicPUzr1ZUd5kUyyNN21OQhR5FS0TGxc3vRWtt9o9sgdmcLFiJcs1Qd5ylWp06RNr0FTF4uPFT2YENqf344IKc4m4GDzhWOJ7xzLbDlW2Bm5KkkICl8K3wvbwmcFgmLsiEMMgxzPiviBA+sQkq2YgCJOY2EySCfJCVYB7TWV1G0XXrgFX4R4Jj5+cGDjjoVcEN5cYCDMnNADlBu8eFEwb78KReS99QMK2qTyVkOZC3sNs18mAQLgdh1pQArYuZpX2ZcFoEnOMxGrahcQLLA4iFC0xVeHFuCAIGQd+B8PYBV3mU6jSB4LaxdAQSxUM8EFioMncCYMyLejbsfXPNwSBEk6QD4eadItcUy9TuPW7DrSp6un+mquvhuIMSZq0kyR9vKy9fre3Lktaad2bZ8OaGxHdGKnNaVLu77p3db9/bHH+rv3p+BGfkB+Agpk0MCGBHKoQxNawhre4R/CP2u8Jmu+1hMeKDzsgG+5rW71bn9wuTd9dPj9FJxviXiQkarUpC4NaUpL2vIqCI9CAPLR8UqX4ahSDbpMWLennbzx5PEH53xY49qynXEzHimy5+0XhO4D+REIYGBQTE47g1rtT8/tQw94ltjgJvc620Rv+DDe/2AfQkeyhJ8DiDdjh2O4LCpx/xRGw0joB/8HX4WS/OQmK1HR41MgwgT8++U/EVX/rwAny6nnn3o4/6Hx7/8vChjRUtQS11IYoFxLpUtvlxyWiEs2C2k6swujCx8X+hd6FpoWchaiFsIpqPSWD1Xt7bE/7fZg3r8LJzYpvrhiiym6qCJHFAHg2t0Gv4S/QXFRcg4SN7TkNgJkWljJyJYppTIJUiqlKb1ihmR0GX9T1+emebXIJbUJ/Mz3z5VGivMFQpFYwuZIZXJFLm9GzilVplyFSjRVMKqFqVELK1yHTl26ffbFrj3KsAi9wdSqU099eV5/LBrVmCZpsqbIiwY7HRsXn5BoHF9ySpCalp5hbSjL+ftIoMcQrJZ+wDqyoObOzikcnHOce3B6AI9HnHWRzJErHdLqi+fe+r/DmoGWjp6RiVkpizI2SsXUNEd5bJotRuy+b9c3DDz0EAvbK/5xIKlJy3Rmkp6MvE9mspKdD5nNXHKTF2Lm4aVJkapDt05dvDSYkImEfBOAGwHcH8xlzXeIjSEhdd9HX/HEwcXzgh/8xIDAQ0tmLRyE4warxCRZUiRV0qRQQqS0SRmT0qH4qmUrFz24h6RjhUuXcRcx48TfRz7XJm2e5CxC9gcU1OT5CDE3j915rYCD9BnqcV1EZ15RVs5JEeS6mlbFwzHsvr627qwkiGd6Y1NLe2tbX39Pr6AqK5qpG5ZrO1fmwODV0A+iOElvM2cAgW/fTMyNzad0ZiFRqfB1UNOpkqGq/HOfGK2wqLiktKy8orLKXY0nEElkCpVGZzBZbA6XxxcIRWKJVCZXKFWFRcVqTYlWpzcYTeZSS5nVVl5RWVVdU1tX39DY1NzS2tbeEe+t0uoM1fy5oSP1NKoRjWmyJmmKpmp6iGYKj4yIio6RwkoRVacYTFEP9UNcnSZXs37YdRu5p8qWHr3WNdi2owLDkhXHcMU3qrVvjBfjc1GixtqQb30SJhxxJT/aCwGGBAaDIh45WjQQv4gg51X5cF7f3T5YsOsn8Uso25F+gQSHxdtCA/KyCXU+GjWm1aRxzAlKhFg4G0CLDbCtAZ0NVPxO27/854arqIg1lZfjo/J+sCnYUBpsES6UbT4uULpKRo6o4UIJmz6p8tSnQB/T+6O8++QpXC4KaUABTmmK3VtYjCCX7nC9kObNHEbGgF32zJ55jVV/Q9Jo/+X65g52woZbXHTDMhg2slszo7oRynywYxO3GCwEYzUe9M6zquolexroOzTSC7ZWHWmsJyoH+s0YdKzfMg+o1lZ45x1OCxNqYzeaBpNCEy0I7vVL6qWZCspMuXIkZU4UWRBg8IXz0sKCea5gPW2nIjK90klTQSLJX6E3KCqCyTloBlpiFxmzJXEqNCNTgS6FEQgSzUoLt8U0KpHe5hepaKtEGpJKw3mBvKs7C3dAlFHBgiUmbPqb475/Y23t7TGf+07aWF5Z3tgEEBfT58Mm3v8eGL371w9gIg/28S3xdaPFwtiHp1zTLOM4Bo1YI21MqfqDEVMHdBO6Df289bSirLyucG2NUxQqwWivz11W4h59B6yxyapL6cuiJFDggNXk6uIS98rQBXWeYFKXzUoxL1SKghksoK27LjJqYqiA1YkyNzeXbQzcuOZ5mVtARTHeQxa2LsQOAnRjCPYm7POVKNLRkfSrkR5LCcQy1HQFS8IIJSIOUJDkMOb7sA+vuBcPjDps/f38G0So6qpvWldMYRrpxoLxCKoeuaYIgwhVUvoyPExZ9ap/jQ0iVEkBH+KrVnoQot6/TzxVVwARqiS7mr4Bn2Ql51aHSzm/v5wb/w/NXi1M8Massdp0wxpdXX7vELP6kq1KpHTQDcgY+shMfsPmyJ95aCLU4tEs7LmzcxYxZSDnz+9JcG8XC6HGRD5j+OMG6EEYca5UgsiVRJBEmBJKZ/9Bcj2BKPyfxtYHu72F7Y0CtHtjLfuukVRQRBjZG4JnjuJBYWrHxo4gFSIUpTf+S4q5NQuBXOHwcr+BeZeUH3m2PphmX8vSokOdnGz+/AGIRie6jH0bFstbx6R1SAKFG7VcOBzFH4Bhgm2UzJGSgjIFN2LVgamML18mWUQw327YldSmrJ57jfzTSDVQlDs2uuQyRv+WXY2YbtD8MVqVZiLFzVKwlKCZwjk4bO98xy7KSCcXfsUJwJj6XJV3OcYf3Y+UU1wxxs6I7PXol6fWpjtu1lP0mfKFFK3Lwaj79pTKdLK1C/2kayo3rRnMkG/Q767QbBIRCv7zgogQuaWhavU7vWnh12jCEmg0HIDpxobpK2rpzJly4Jb8TsV9yDZ3mxlovisf0XdOZIl5YzrghN3WRMCCAavrEyy9WMqXlYcaIWMJ/wwUDHAeueNZSOhB02Tpmtv0Z2A8nBA4BL0fOUjIpfUAAMS5s+wP+hj0RwcB75EdV3cusIW+AOfPejyVFgyT6+IbVYkcs9HZgIuOEWeBp6li0WxYsYp6sSploiVgEJTVzNR8mBOZe/BHSKuipbfsWsmP4g7XjvSUhMfBHcGsuardo1Kyu2TrqUrHsIrzHq70UaobDPUeMnmvrJoSreuBLjeMzSNSxE2RGzVPdXD30uUadJtray9dN5ZyHidDB8ipYWR9uiC8TdXGHV2nW7Q3Mqom0e04DJmTT9IJrbqT+rEB0+oyGlOdoe3u45/2VRvdEPNBeaJ/jHofaTllTFA/OOU0FuvrKzBoIVVHYs9dypecJVMPcxMuxZ0wE37CcfStR19IkvW2J4GknkxaXKkcbKzBONxOgU4qF6tvRnYxGMkbpuW1gaRUcVXrRMoiehwFCiaA7YbJ9IoHQHKdLFoTh/ZgRY4/VAk2vrsTwkv0+YNBTrF2syl09lOzmFwdM/6Gn+/p9xd6t4FWRlli8wvzNVq9RWufa4RyqlA/WSIiog+2CNt/Ih+IxazL7HVDRGQkJFTsKAHr87+mngzGvFBVTH6SybXXoJRKJTeW+aNek/UxtIK6VhWp7R82VNHcweczWhjq2wy63lVIqpTzaT03XNl1Z0F7RLjsdJYF4pz4CmnTt7Dhk9mZTUQGnRaXZWD4tNbStOf/8t0Fe6GWSwsmAvK+b2RygtxhTwhoItNBnyCPrDCUPjNDXplCycDDECPaA7wcRif8VD0et/nyijrHk8q5GaikdoUAjbCOY4OUYHKIgoDQaqSHVlsq0vjvR7Gijjy+dn1SoFDHGxDV6BfUm6M9FWGcm5Ngml8x+x1UUJ0kSUSK9Mhwtmb6JkRGTzX2WlNeWe0YprOhsb+yr3tzO5dTUzxfJnpvKJTrtkxJowOzIT69FiLGzJsKGi51D6TNIZ+NB/WuhcSivgS38xVJfVhnqoHEVYD9bvMgJEbJMM/0hD9AU7tMuTKxmi89rAa5CtyV1DJZqeUUBr2ZJ9Uy2nfoiFf0IWCC6NrakUTrz+VFMrlTq1Y1Ko3X67vbIzXGOt246bC6SBtjxzJzX6lGWyK4WcYhZDfEulYtLAXWMJER2tpG1wunZuMrWQkHNQMWA9Rzl9WtdJqAPooc+IK627wFhgKe13UqAoOPbxY2dEhluGYnUOXOwZrJYfFprpyHOZyYDu9Y+z5Y5tY3liL6hmByeFlxC4jHOyL4rrB64Z4usTlZt02kCDOkub2pVOyvy+es4EaMQ5aybib9GHrLb11U9PZZrIPGgsFdTIjlOz5LiG8nufjaVORXOFEsJftbGpGqBD7Bk4WgRQFdrQjwYyySgyJAnS0i1+HCBf0/GKCA/abGuXXRWsMbG8m76H0GbQ5Gwga5dS3cMxRlhQj4sYumjx0rycAz0Oaww20Czfp/gJm58ckeq80tnTBUazw0WIAlZrDodD9DPKpvrifBnfAH7fCLIzs+X0pDfNBBQP7lLFzcELG9e+zmwD+qEktYSAMRrMxlCpBxn47nnRzEXJr/zOBzyC50eLHrr0Kjz4zBoo4KJq3TItobWD/XFlGPT7KRgD9QmiMWokcDlT3oS820ANDJxSNbvKBViOitKlak5pxG0gAPS7o1DM1IBD6Wv49jxLe9Iw2Vl5exvog9MsvaPZsg1GLWKK+t2qESabyH6p2wEiz0Nvo9gF2HNiEoZDRaXw1k7B86IN2MwjGUxQLgWFqTHCDWUHs2ZmrLFmumurRrwrPuQl3z+7BDCUtawdT6IcG7rPWsGYvsHtXmoKOoAkqBeCyvQZgX0cDSyUo/1O0afSBLTHMZGxE+U8FWq7N4WKG1Mtt4rI7CvbuptBKdck4zkpKlcqMR3uniPDzOn//mEaBYT3ZyGGVCZSxsFD52yPF8QgnnArE46AeLehpNX0iXoUpLZ4VhQtzTpjtBf2bzK48dOQUVoq4u14T9wJMdNAdtxc/bbOb96yK8wwrEsAOotBHdE+qVVZepsQlRc1CfXnAl+D7llJPWWeLmlsvFp1rrOzuMhZlOHnBeVFdXJw3N/SZiRSSbSgvhTyei3rOm6+gD84x/XthZn4lMzY/3KjPzR7+LA/BbG3GZAXzEy+M+d6oL2t/k+kV0Ff0c4DCxDsTrNp83e2wZNn/fhdC344lZWXaQIGUdndH+BbHunAhgV5GcIJALhZzQMlad9lX7TtkMkI4kBvBKECSbQXY/ZpLCMFfRtAHoSYfUzp+ul1xFG/k+nxaCoveMXKDF359vfLOeMpSVxySA0xngsoibzhVNBxh+spULMc6q2qJ/2hccPmluMm30WSxJIYb6RaTDyCohlfrTcF4Z1yITaxb2wmdhntCdyZx5CFFHPG3bsP11/Y3Pt+s7q4hPWL0p65DNWOhMt0w2XeIcX4O9OMuGajFck2UWQpBa90eDL8Dl4eIa7OJLKsJlY9E68X6JRldLJ8LUh9D8+gogIJMnlh9y4YacuYmRDN0KlpbnAGk8ziOBxphZ506tgM0KFOF/61aso/sFsXPvLnQW65SVphjQ9L0w+h7n/CSX6TQC9lY39xjL99pU2tSz73KF1UJIzi9iaamT5cWSMS73VmAJW3DulvknNj58d9uOB9Sb6BN9NejxCZgAqcc+MOvRp0xqerGYtTUcVeek2a60NRFnmTuR14URa/HEd91+MbmTltRIaZe3kkgU160Ma+IgOFFka9zM+BQlZPV6rUIUXI/HZLq9YquupYlhA8eKvS3AbSKptVLWFP6Ut9HuYFC2eLRq3eZTFN5oP4IGNOpTaSXXm0MNs8oMdhoVU7LszkBtvp1XjHEoFy0XymQM3EC2+e48iug3Cw8Ei3b48ph8oDj/gE2bTEa7hyTeXNDprLJCAYsdazSRyZjZWs2URM3RTFB2iHpz4gC0UsZ+d9sfMsblUcjRptLqzpM4T+QBYTKVs4wZ//pi/4wnchcCbckGFFWNPByKDEEn4MOzSJNFUX6I6DgKfNaJwUzG3OopRKPoE/Mj/i5qbjkfKjSlR91LsL0JwO+Jy7YV8XwDsjyLmQq/S7L5AqmYWYDOxAGTZ5QZenID6sc823oy2tjDtAlMn5JGntFOm0qRjwGcTknFInfViIjwc6MPdXN0bKhxM1xReOWQ6oSQAmclEut+KcGiARvybsLimfojefJYVoN9p8n2gvrS3OEp2rgn92CyIjdpdlbDyB/kUOA3zu7bOwf8BcgyIRBuUG4g9xsvpdu7ARZaJnLVI/U2dh31pcCCZVriMdDegPXREwhUApyhCrMrOF1znC5hO7gMwQdS9cDvMTM/CuXW3AWdqhOLOoI5TPvFKCA1oeBmX+4bkkITJF7rdLqF/aMWi40XzdhoLgeT0UR9w6D8c8utuA97kycn4kmrxvjF/j8VMRmOt2O78Lw7al41YOfrukC2O2jxNF+atEBSU+TpFLYoqo22u/3mYNhbwEOl8bRkkxRbeNE4j5MhOzyiqFGp7FCMcSRnkBnZIlJcuTs6kLbH8ymnv9OovNuwAh9B6MPVBUpnCuYYCvf63X8HMEWTOGYwynqfmEx/X5vVnrH2l73EIbJFT73Fmrdq+2al32T41u43kaWz2KLnu0J+OVNSzwubqL7QkT/dNrCIRLBOcyXd1VC3KwJNVMhEXX7oi2/Uyx/KiAyaQofWIPiQKggHYASI6tY5hwvxYAnkSQsoFIQiKtCqFtGegGAYVamyNLeMNy7Cg+g46KPXg1CdPf3/c9c/zs+nb5za20OHBvfdaT88xyjNHR6au3Z2LikXelT6lG7gyjum5OmutwHsHr+/pnAPRzTeauyr6NAHuSyl3mYkfB8eD3CeAYLYKAQkomcWA8Ry4ejv8w09BELhgZxHJmXgMkJCOBMxQB9qANkuWRf6+WY1Yr0CLinnDethPCLlQAsMA2pWYnxP9dHgko4zqQ6eqK5L5MCWQkXFH8k+dSrDUvg1rPsgq9Q34v6KS2d2W9DWyJR4GLFozdKEwz7Pu7ggImDBHRhqlMkXIRRLmJcx1WpPs8BS2YgMZVGvNKwCvG/DVOci3pbhbEi/vu+7CxzVfvJ/v7fv/r6j6GThdX44PAr/lZvsYJnps9PeOPpNMcutHjKFGLV3iNsJuANLyfff36nJVGDVt72CAGv3eb/013UV4vBP2lR9DL8dtiL2HKd5IJZpdqCFs39TUUhpU4VVbbhV64rE1wqv2WUidzcUtvfq0MCqkZtK42FfYns8wm+t+pAKYr1TlkS1bl3kRnSw6cpit9mG7K7KyLPF8nLoT7rCk/lCliHWR0uMjjURxqjZoE6P2NlqQOLdpNmBMCuPD8EwXBReQHtTCVc2EZkblLNqrIKsTN1GGuwT2lFtpwRGD4Hdf/AGRUfLHU/nfz/Jiw3xhrkVIk0B13IzK9XT69p41PxZDLxLTEuMaFdbptDSHd2ofY0XTZXQ3zmJjHi2NaxHNOmKBNMOZDHFkITPsifJQrLSgBj59WENh9dAvsUD6n7RAF1bXEhSKR6v165rDsTZVCzgOnLEe1dMtX9H+e4qppiuasKxc/1McQVVAledkWniM6ImMFo1fRrUKUSTSYFT1/VNw5ncXaqK6OSkk1O9JEa1oWDpIRDEo1/+E0bLpfCb11478BD0qRsGrlnD1c647N2cbWFDgJujtpBJokcD80gN9/qSbfgGncIBL62DC1UpSm/aOU2voH4xfWG1ZGSNWxurvmRlXkbfCpq8UTPGOFtP2dXTtsM1YNh3K9fnMoZY7xyTv9lTDaXQxlhSZAOd268eOTBhS57CFRJYY2BsiGFNqyNQlXF+uEFbe9CpG9REjeL8DrcoLMhzOnkKgykudihr/fd7HjPwTCrWRjRpiw5MW9AVf4UHWPVAmgK+mXUinMoTcQAzZOqXF7DSRQorxFgpYq9XJIk9cPapkk5w1eKhXD/a+fQUhzpZyS9Eu+3fyLm/b4ojiP0/MPm/r+Lwz012IIy3mR/8/ER+20MPqXdOlyy/cXzvp0+c9H33jcJ0unUusBfX+KyCDQmje5GDcOOCP/jGF2goUBvI6NkmXPQ688iXTpxO8fCJsgc+dyDuH84DO5vr6UwFU74G8kVYb9j6gnAOL5CVxhEwaxRCwMuuf0lmfL/OAusuYwPZo09yjj4u0aB9yGNmhgHMiWdiivMA3TRYWRomX30OByBSxOKJvFZawzrqU8s3Lcb8yH/eb/kwoIimGJlSOtWiIjimXKD6pSGyESzBJ+y53UhEVbCqX6SliC2bfj5LF9qprroG5FtiwSDQIG50JtSXQskjqIyd1SALNV8CTPUrgXjkKE+HiI4TwXW2SuELqlrBqg8SSHuz+g3a8rBB7BREa2yUYDlgSeDLC5eevbFCICvzswVmv/EXLkL9uqcD6cr/wVF3axOSugx+iKJSty3RA0Cd9orVFnQVBHy/lEm7uX4MJ8scsdTRKoWdvA1zZADxKtyFlOR7+YQcobo5NQI1qR2RaUottZycg99kYJWjXcd1DXEjpfVogSHvKquaRD59F+sKJiTiwBhZVZkzWhrWIQkUCL5Z0Emq3jt5ey9nrEEo+2rOUVwQovrw3aTOe9uun7IuB/TEhjVgUJcQdwZYp+C1wo+1RetYN2pH6IB6OnNYpA/gmnv08rPlHnAR7JPDGJd5b2qCFZn+PXbtSvQryP0aCUj0vlCBqBq4HzZ/yv6aKo8k+rUm4RozVfDyGhdjdRkUbfo1ioOoZjH2kEDkQEOnMEDPeaH3TrR/h5blPYVaUj/XIdAodAQ+S8oMgLRKhg3OPVZCHo2VgBl2+ImTVDgmx+DENu5ooS8Wyw4AtOlaB9TDvuq2W/eV/mj0zT7dHkQhDFxg1G+ip8QtFXmtQquN3a7C35IjBNXKAvclxS0jI4d27aFhvRydjTyzc7zRpcwxckMj+TeyevXfwK/FvFT2bgJ6G8SNDk6TB4BbCmYKo0k3CpE7ZF7Ly+gLR+QJ7UuDbHwHQTK9kZvZ56ZDiJT0shhiSeAWeyeERy/bjP82MVtswLixmv3x5Y8ZEaFv9oj4j0IlaO1gIitoCvUhq3eilk7jVs9YHCdH2kOtxsemXJxJMbLC9AK+K8bo/3mIAf1ejuABkWauT+R8vVCElT/B5HLn4XLyi1ykdRaRql0Fa/1o48ZJQCJpBngdugu1ICTd0iMaGQuJJ4sBfYwDmuJuSg2/hQRUJeGwi3pKdBj5NTUZPmBNjk9CBt1nGrdAA03Z0GgbSWtiyxULudNvqjpVSn1K0xzhWBnUQSqYSi2dDjp7wTRt+s8lmuJoyDF18uOayu9UWKMrPtSqoXCrXLZVw8jwht4aRoM/DDCgzD2O0xSbYbtamIQFRj/3Fh4Nl7zNPGGkqAqX6hHk1wsMKAs0TE2aXTH1DNyFCjleZygeIaejypMHiKhGW1w4DDWYMzJiyyemAGHCEbB2lqR2IuXVyMMmteWcZZaar6yxeUMGC0tImp0SjZagyoeastdmrQewK//tgO9/dkeP0B9gQPR3uv9zS+W/nlM8QDD4NBlZ+2FG+zLmZonRYMXLtCtTt8lMXWzzVz/yVOeouyjXSD5bJB+9Fu0A3Oec8ZMYHnWHHRHMTXn4fuNexRqXPNXnggrbvjQxCGcK6RBB7gY4kOYjQCpxuogf5Q9vaYvo4o/gR9ErzU+9XPF9BkVoATUF5Ahlu/4TNksrp0ftmeXX9rELn5iq+n53jeD9kYW+7t+U3skD4HV/pmL7TUY8w8CnU+z1Bl6MVFjT1igzsfOUfZWsfpSAVQt9wTOTOGldlTXZFkvz8r///BUUBxmcBvkN+UPiE818q3EPTApVtS9Mv1rLAHA7tbraHQ0R/mqpzCbJWqMffG4WK9DSxZvtJcbnmkwTdDoJ+eVu7HGdwmOFmpQSWm8ye2V3NGQ0OhoVWPPlgg19uYxIa+SVFSGzZu15HAHg9m1jx9B/C79n9jOFr8pjPjkVSTAxKCrvlDhwitbeEdlbUKLbZUB/0/k3KxB1cBvIcQq2PpV8LLW9pXhP4klcgxeXnKrdPxmgim+OORW0EZagKXS0fLyfs3yuUxzpmfNMOPxTN+4jqfoBt8FXyL0uasgrC7+sHEyOugqDaR4Eyvfr2nO2UVLKQfW8nDI0xJ6vLfd+mmH2liYiqSFqQa7UZqpwKY7tH2oY4R9OOAefshxM4rEde9SxEzWzKYcogAQpXdJOs8W9tfoy1ZhYq2shqzlaa8hhsehoSml+qVCnkBYS7byzhz3FlRZDi6g7f+v354Hcl/zA//PU2eXWBhH4OfLr9Yq7lnnVVJFA6ZIGZpvHW/qGfWYNwljJPaa01XX7cp6e1UR58SVimfhssFApBBWkLeU/X/jgZ0orVnwvNXJHqlVvrqA1+xNeRCOEg6oufave9uDl21Gzi2aZBkEyWjgl8jlZYe0H4/b99INhTHOxxiypiAFx9O5keXuBUvXbb4ncPMpkjhAJM94eL4JK5AtZ4/1dzFRV9vOcIXaM++LkQ0LJJd9yQiu6FbhYMh9HPFxzPZxgkGssVDWrYX5OQKGFlcloyW01ifVLIoUstBqdU0y6d2zwiIPOj2AH775TUyxXpt3w4a1RCUKKlEAm6D24kxh3ZvEktNRAyYgyFBrwQpEapZlrNTrF/yuEXZrX5qGVZ2itZYx122pcvZRJS0iFdf2OeePItGQU2+Sp1NVSttRyOPBQJFQ8kz2KS1jRMRJFEX8oIbtyNCsdbZ6y/wcv6BciBGaTrpKqT5N4+zs0g+lqEM2SkW3nqvLIe/jiKI6Yal745RsimmtUi3NpALfT8ZVmUnZOZcq6WSblCPCNy+kysVxoYlsEsjNxackwptFZqa0VV1WsRBJILW5FypTiSXTKWyYVWYVUIyaJnUTCCFyqkPtdTNOcBlqIQ57eo5KF6WVT2Lyy8gy5Oq130hApO0egcNJlqlRvA0MOppU896MaVYhWq3JpcHbN0Y7O6GdUYVZ5Bza3rCxLoU5jfnzUwc0j78aKjZQPxopvlnmvLHpzjsBiml8lH+pxvubfODzOS6VzsZvUOmpYdQuK/vMChkWJgt7QhV9Qngq9oxOfsvR+ezcgsSurNEUgZ1AsSQmpjKeFzeL3CBenIqDxVKloTEw4kRHRzqsddzOK7IIA7zplvaM8R1yXlgPSVtbfDW3b92hDpvuRb6MsZsl32+ec+lKrLT3ULqzP2dpUsgNrZDdi9+InRpTHnJudns10ncqqVikpq85rf52s84vTWbv9kquyxMXSi3LRWmlZEJno5TS49GXUkoh6BI9VjZ5WYwXjSXVMBe/hcedE0ioVgiZ2n5r146WJP6y0keZj1sBGTjvSIqmy/DyL6tnNyxe0JJfyLyXhExWkAmE2M0i3EkHK4CUlpxPIJd4Z/Y48sQVwEzflEq8I3ngwJw4Yqeloqp7NwLUG59WKJ3THvGHLSeZCf+4TV7IvSDTAGGIk06xrby5ND1Y3rycSW9n1dn0RvSS6GaYg1trJbpcl3LmIc1xu3yxsm7G6PJOSLb3B7wMbAdy+dfawG6yY9pSEaLA0o+eVfx2LbM8xjHR18aW+VIcrIEh93COnNOPxajIm9br1TuodqTxrIE5NFFHFRre69ML+DZd+C0JMUagmIVu5Btx7Z0+ZjManBgegA772qi82X/vImj5EXDAvhIRa6qOE0HbbrwflNZ5i3jbQDRtll2AW0QVyK5cF2SOA0F3Is3DLuRZHFkpQIyAIS9Mw61mbFc4hDmq7ayWdUGEkcNheFOVeFAsvlJxDHxOE3511cggKqQAN7s3Seoct99dw9LoLWk2BRDWbnaYnf53figeNdjVzHnpCd7ZMTt+VUH62Ppik42LU/qBfTmzDReWt1Cx+TKghiI57XATtoNXzJ89abi2vCrodkXWU+/H/H34mqievWpklH6SaUHw4eJpDE+FfEAsuFJ1PPspndrnzfmK/5HLacKZURN6ZUHH1a8H6riJgR9LXeJkIPB+pZs4LuMPt+NL2v8+3g4FdnLLK00wQ+SmFiuNE5N1uj4/BkOjlaiq9K/8XXNJWrltdiZmv7KsuHku8wCnjNqdu90/S3PUxtABrpauYKMxaWtA5pydz2sue7j+58qMwcuu6yT8oMWzZaaPKREiEF06YSExLXD/O5j6LiLsKG/I9VKSpwbuDMWjFptWFuChylFSULbNYsmANbacOvf009TnxUKBkVs3xiZP88cRBAmSutP54ghTJp9LSGy25CbXIUxDta6U2RhCQ+yxXCockMMquLtm58Zr8pU/2LYgjGUpL5I40y3D7q2v3kwqples1PmnCAWIQ02SWNfHzaOKk5gBJpxx02iy8QqiVYnqqJLwiQcmUe7/blmWx6KmRfo9lBU9PTWRlXBcXOusqG/S2TJLigsJAJR+9UhYlhWsp8U9daxydFHkh0PXtBWkrtfwKX5va6L7bt0RLaE5vNvYQwpaTm6eye9u1bdn7QRGopF9u2730pjAG5uXZ+IOSUpJarMkek31ev8GsLVsOlaLv7PZi5cls6oy75ZZAByU9Gr4nZ3cjM4OlnqhqtXD7FQSUtUpsLqi3t1B+k9qIxcs5eMaminRWVmyBwuMGZ9/pNz3QrVSTA8Dti/M74VpK47oIe9SISGclbe2Dk6kG+KAPgppO1tn3E92rB3YyhZo9GX2iJo5FoyyQTT6Ijg41ArhdwrDxtLhwfL6RZmkpai9uMVWYi1dCv4riF7POpg5VMPKrFyqbac2EZnxr8V0ci52h0lTkONS0Uf+UIkVdz20fHJ9mZcv4vKEk6Omh/cFycg/0hsfZjsTtV89nyV6tZ/Shx9TjwlGUeDRk48eJg2bhOPR2RsfNL6LiIw7NESUq1EqWiDg+zjiF/k69HX7pYljOEmZ5yzRFeRqZWq/SiZSMjSGfhW8MgGGcw4E+BPxbUs3pnM2a1Qy3gJPtyz7n9PPhbZUlxqQewZxT++kXUZ4Rk3O7UFK1EpFAv4lz6t07jMPSAc7ws25vVwkKqU7Q5GnyVNVW2yqrDBZx27qvYv4rSs+mdlYKc8fW+A6q9oQy/7dr0pW13A+qNP4nwJjg40PHZJH7hwnhpen88jy+hUeFiacLLXZNAUOX2F3Pdf4U9tId7tyMDvFRrlM3XV2n+SnOw2gLxwX2p/Mkt61gZXiw32o8dy9NQFa6NrdmVDSLW1OmgRZ0Rl2cHkoTAri9vPJtg4wn3F/AKhEr9xp3FybD7QhftyLuEO8qaoVLWPuQeliqd3GWSZUOeYHJdJMF4Pb+tZHV2NpvIq/mhlamkLYJDDm1GFXayd9WWMaCXyXo6oKasJi+Pv0ackLIScq34kGQQwqEfiRGb+rIjaHRVGxjK+ip4/PVJvyNkw8nhKNmmDKoKYqcCiKl1/fPUWz/Aio8AvP8dONftwl/z+S8StBGinMlvAKViZ+Ebom/wcYv5vWJ+0N1jfLHp4nuUqXNQVW9VEBhoQGwAu1j33L3gh0XI5hXG5CFbb+qvw2gYByUtenx4mU7T6SoKY4nXJd7B3A8rs0UNOfX3FrILysXlaQTqhqw4j50J4eA48jtwZYmFc7/7iKfGpclfk8nKijWW3gYxBSvo5kwmpeEvLS4sVthlV+3ID7VICxeS9EywHjoaOdlzErh11hb/G7JL61IS3Xl7UM46AFg2ZUcVfxdBC2y0xRfMqGSYUqs7IJslcUoLqd8snJi+qdZXIHfgzfRm6VdDk4iNSmcOfZ+BM1ilTACTWlg+y+t8axuD+fScqwoG/XJ0ZJ1iClqejiFuem2olse3yA+rk412H1PIv7Dzb+H9wyhPkuF4zsSNbuNZ2fbYB/qvsBAWvdCKuN5/OTxpoH6341Gxbg0/i0+86Vcl+WnWVxiMcoY9OUSr4/ENtEnMY/fxHtjiXgSoe8igNuZ/GaIjqzatXiM/XT0uukxQ73sCmdT0QPKnarYd6qH+eXC75Xt3VrDojkbnGAGCQghK0J2MlSk564KHOKPs6gMBs6Ll3U5SrKKG18MBRStRAqikaX2CGN1ocDMpSDnIOJzgZtwwnOcxVJlPKEiSuOOV5cFCHm5MgujIEUgkwP8bw7H+cpuNLMaZcJsprJbLePmgrk9/gelS+sE6246cuICJp37c/coGiqZROhsMxY/ENtNbOU0KY9X642MxhQC94pF6Bem037ibK7LMTZJzJgqQ+53/5zSpQqsRqWFY0rhXc0+RiquElTHGgFZ7XCgowf5WRxTet3XpW6pUN3EiSA2TL/aTdIqFDEUuSIXU3MRY7IpkD0W4irDWLgEYzbCfDsUByWaR6Nqq6IpV/9pxG+gmEhOrRKpWx8P4uMCiIGNPsa7AFwi1fm2AkbCFXFo6JN3JWB+TwYhJd7gmWaNh7NpL7b1vw1n1qbz/2E92me7z4OxrQroPvMyLvs8ZFx6IGt0UqIujttZ1x7D2pG8IDyLK7jWsmu1M/tCK6xXCQZfwH5F9/zrALE2eSszDDE7HLaNIwe/fF3uV7k9KOShYpn+QQAw/QNH9m7BiukFneRhwPmK53xh5+NEUT5NhiomNN/YFROlagOtU8kdmAKlic8SlWyYdc+xxRCxU1cELW0mfiHhT/8RDMf067YY6lRKK/xKbuL2CnjAjjwg9JOYRCiW+ip1aOdy4nSpvIiQTDRZVJ3aupiixYdBcoST0aGWrjrTDjpIe7xJetHvcHCwPYk9Mun5n9eJ/YvO0UHd7F/9DdgupgNBbxzCm+kOkzFMKEn14qFse7eTJFlW/l/osxLogNcvzq0MBCLmlmbNJGE+7qAI0Ge5OYjVrs7cqnl83sl6c4hCfJGtIsJWvk1xZgt9ZVlXkpdVZxSzol68rgHMVkKPFpTKh1Ok8z8Zrwg7sF5dkqKXl1bCqo/bAyCebFG39LT0DvUQmJ1wOOQ9CWyxVpXLZAhv6Ns2MbVIH1PKs8pZYR9eawLTV98178PlJRZRgnJYmeh7yUPRbWIProDsCCgLN/N2CRbIC+Rl8iJbWBzFPU4PigM5vzkclQ7wyQ76GfdDLn00jncl2vDq++/XBRyee8Dz1UNdUptd4NO0mYIB96rXathKutCTr+m2FbslFsJZMGeBo0qz6rJHRaz7XbkSguPnZ71S+2xjunF6mAsaUg4tVbnCc7zQzk2Px69vMuIGXHsppMhjK3ynCBJYSPFROVm4Ps8Q0v8G5mRZ/cIHeDFKqSt87moafmpMB10X2PYZWTYLQh0qJyhYZz/io6hHsldYvG9R4Ct6OQRTZx6x/Q6d+QJtu4AY1umt1c/83qDP1Avlenpg8OVT/nhEMGv9eKX+/fLc/FUjNfepWxP3kLNcLk9R1lNTOJZ7TL/MLwHh4MXN9c/DFIMuK+QUTHbs239PKtGRBpvgwTgkVbbW3dFZOViUPRcmhUkb6DSoDOkpk9XHjbH3x8aa53CuJBYZQcKnqNafkVXmQqN3+F4KWCJe3mOPJh6Hl5lCGbevsp+9hLogu4ap2k8mx+Qy/cgWZbVWvtvpaDsItFECVE6q9t0rYe1Mv6puhHcha7671TpLOOi4KpAkPHpN6zaU9d+jU34ERDDzeFp30mIlkXtUOKMLicUj2TRXw7zc/+D/rQYkRUDHKSXBXBWo8fvqGYwXcwrf6dYiqlWGnRD1MjOikxxFEOzabb63+mpwl7JWK9sNFyEIxBeJwkpFzH70JeY+WgXvhMtxucC4rmK8KPtQmBQmrKOzyLXJ98ViNV1SnJnEk8n5Vur/tsWSZXeikWbgvfk9x4ZnIbJBmx18CiY6AE7QEzny4nSpDy5r4dMnE+Iwv6dDguTgmSZoeNcieRGyZRRysDQFj24uRE0ii97gkR/zqU/gaB245WDa9sR50SlEjqrcJ2sO1PXstbySWQ4r7wgfK2krT2QFRa538SqstvxXUsexp5n6+ErACWZfx5qMYUN3KWhlndGWhFCao9HoNICghlzkBfsD92vd3YohhDHuaPVvH3p+/Ph34/7VxfzTmppmAA9Z8vHZvDxKAND8+MzMHsvJVTh0zKmUkwOcZLNgy80JoUraayMjOFwz+LT1aNnJ2UXBqbmWNlJCTS2qpgxqIVRStWY0FVIrtSqb0ilFRZUt6U3HKZHL//+MyDjzdlkHmPj/xhlp+vvtnQUoQu2CDq8mlcaYO2fmd5VJNnzJKyRuud2ELjcCjPhhqCDlRMOcnpuaIPqFx1NY/KLxFL75J9N16a0pl9xQW4BIrCxI1rw6b/7n0CIDrnOJ7mIhs2t3RDUReBZZn4BzSwBffMNXIhh0OfHU/QXGilyuoml/+xZqD34zXRATPf8b5Pv8vc/dOgOksREVGO9FQzS350ypJSCrZCdKd1eM8OZYUvImrYSrAp48CQHWarCPQYFgE/lsMecqNTSsmIMNdrObSAlIXXnu2al0QtYJYSd3mDUJ791291bTvv1hisUsHlOytFpaTdzjfOiwg+r9YCd653pATIJMfMRy4Rj71Kzyya9w4Tz+DRzbjS4iMo7GGTH2sh/kXNfS51PiCMb4+DImR1pXQB+M2IbvFAw8cooXm6s5U3GbVk0aGLBVrlwTldr/kQZu6BgUJkw1tHVzpGAkbT1C53IoNvH9H49PhzH4EnM4h3oswtZ3o3q+sa8Wq+84Tp1MGSTJKU82IscUSro7zpdmist5JJdLiwJdIpdh+q0l/WhOgD171wUt95aQshZdU1oQNS1XpaAb0eXK7J1bjHRHkosUCf5OHTMtOemPLthO8kWudXoqRVz63UeZszlXioJVmgPjZo8JeLHDOFIhIFbNAOAmz9fGYRFmVAmTrUR7hWLjyUfUB3l8BvuPzcy7XO6yQdptWbcEEO3F5fpVq7HH62p/rnlC40AqnjpjHBxhQr1m0k20e3e5UPfu9Pt8NPfb+O60htlvWDP8iXbiMj10Z0Xzkfwp+a8EV+gO4K/r9Rl8Es7FlJINfNPBshBcQwTS+XMCUy5UakfDOnQvgAfZsxdp0umzSa0bmzjsXqQpUFzAvyLO0vMMAnJxccmGL7kCYAF6l338Dknlc2l/rDZMsARD/sMDXttznxEUV51mG2iJ4nF1FOq+d/n6wD9aODkalCu7k5YrOGAw37OB8SGScZ8UEr0+oZd8pNpMPrKRWCevyNhOixeA9GHjysNPXoUkimtMwogkh+5i9sujUPdfstwSldn9BTxlVLB4exv72i7afWLbmQ88SwqX6loWqGVcB4dmRtHLEzQiA6w5PWq0ZFbMRJFcI5jQQeGlBIAs5DM7ngTxFxR8v8PDlpfJ2yrf5c5w5hBFgk1C8TMZQf1ioip5IuTOTJU+zXnyzpWE6dXUcP5b/xiIgVVFi1GW6gA8bxQchsi7EyxLvNSRUwkqC795hZtzBeE1IWs9eFX56fYLftFDeCll3p5tHswrXrSJXL+4makLmS1sxboVeNHXh8HblZW7SUW630L97o103Ggp7Exj16+3EpVp1nZxRxoXFKTcvCFx9vTevNH6wcnsh7/6yB+THKXzsbYbYQu1pTlygwrdrAJ6SW43e2Np+EhMZ7nUFkhWiuGjyilPv9vggMwNRSaUxlpi85ob+EcRFnPFuoNVzl+lNS/7Gnt0SdUNoHyY7ZmWE1T0HB9XeDHT2NUoxXCEEdIp6bahfCeGaELBvUSxahAVZPjAnGl45sWe7t5eaj5rn/x8UAHCp7fblN3ZdSk+0qnQvbgqxjhjXswdbC+dzuM/WdtZ2bV2ad3LBKmGGk0sd/f08V4oqd720NnjGRk5eSBhVPvxlx0CyUWmNyF894+3yBj7risRCVxciGiMzwO1LaFMkV0RelOXb32ZBjujKRErdFD/nO3YlFJkfRvMc/z0SG35nX6r6WAmB8Hr44tA1ItNkZnbNIhM8DEcadxXh4w8+5VDSAWlEwWg2D1UckeOCWpGpsTgk/Gv5Lr1G66tscX3Pj/NedOr0OsL1r8gnyw+rp/UA9/x73+cLH95eOL20sAf3E6zb8oXD+9E9svMH6eHCAxCu5vi1l+rfyfIVv4ifENxfvuvLIOQcmTXvzunmHn7WUYNsTxZwpy6WgblpVruiGNTd2N+zb8HP1gEnAqSDTX18Sjal9+NFBTTzGQePOuawh6+ZV1vDS997N1X7o3GxSNq5+HWwjT/dojXbVoo4Oz9V+R7PeCasovvfYTSvNGJdCeKWh6hekAPtaQ+hIdsfOGrewkki22jqLPq3Wfe7a0OOPAhJUUm3VhEco/N8A1cRAff3Aoh6ABI/i1QdO0vOPy366LAQ7wXVhQ7UYdgBniWHRq2LVZbsYXx1B3Mec+4ys28KBD4p1OMR5CH5ZsS3AX0T+e5Dys+UR+XVtIhoc6fdRIDeW66FCefec3/Ta9bHoD96ofVSnwf/2l+9I9n8gkDO0S5gZHL/nHH49Zkyf3awW9gD6I3OwzYlyuywZOIDDQ+zzsdp/EOfzNyRaDuDjZwjFA1p+Ep9+Qny786gRPvsZK5swkKhdFWPsObz2LW0d0K4vWFCV6ekATFMALGUEZocWdXQ2ehzwuS19AAIuiQvOoikRPHphmsliYCHPqQxvRm6XFnbmHdM2SC6mWAh3RMofG9CJZxsHRQlKrWVQqp4++qRdKKA+d98HWhVVyREecBeX+dZSbXVC5TjpDmoxU5kZURtiYfuKuf+GI0NHmv78JL0XhL4+22gM2RalHnnK3J6x7nr1kQv89Qgr7CeDP+eRLG28cLDgzm/uPn9GxpWDKzxJUM4PY5ueEp37W00S1wLq3KlXyMpUEbEhIH+f8L54GjQV75RqvgCPiorR2tX02a/+WW/IjZYV7c412f4zeXZl5MHxbgOFRcGIok+SZyPCkNwO3X71jRQhnVw7S8W96esWfld0CuY2r9vOgNE2XU9BNFk47dxVs3ijJimjK5333FFQ4HHx3UJevLZOoZF3wxKZuhjy8dInOqs8dl/Mup68caP2ifOGJRRWtMNpUp1YMvCDRqDtMYB2b16cJFiqOs/h+gQeQzfu9K9PA06g4zC0qmPLwnOKlO42xYYJ9gKxhF1B/IUgxEDreeh9bhpxG2YHBrW0SXYARh8W9DtkH2/A2FBTSvpBDwffPBz8NPX24kKNgT7jgWvdO/pRVTC3esmfthhIQ40oc/fF/oyqP2yJhQnMhJfiTy4bmMvpf9PsDj+nPkEutBjy2O1hJb1oHWpB1/ZiTNbm6sjjNkFya5hTkmbRY1pcpMuQsqTFq0VF3qgnRPjF9N/5aVeXrdL2F8PXpbFdj22ypOY2+8deHtXFqJfyGbBSQwxT76XoWrmOJoKSqir3k2nMRh5SPxz9OQmc3ARsyDeVpV0icgZGeAKddg4vVISf+XkCuSiuj0aLuSHk6pBoRpJ6ewAD7EpSMe7VoVz9s74V8M6SZOhNBh8oUueKxoor1H2Zo7xWbgRbDdb31+sGs0qbEEQoNO3rj26Hcnm9ZVxKa7NCfRgIVDMTlLEngovV7t7nx68Y0EZ+0xwIcIEhq8xuEcnOKX5jM1Z5LHVvrC09+9UCDxiHKYyc6gsBcG3nOFtVW4LSkX5b+Gg+yiEhraCbGFUUqud8DQJuEennd77JdKbS0qRIgJYDdft026Wsz+L5O9/ccKnyYE3adCNBXEQEgL4BRTyfuXt9v5ueQMI/u+D4q2RjdJqNCoCF8c9J9zPm0G/BSPvc8OH/PiSMrp31Gfv/iZ+pz+nK+tko4cTmsFPCncfdeHF0MV1PPpT+kJ9OLnPOqz4pY20tDR9z3/VfUB5x+UZpA9dkEKXwdrv5UNoOorgUs/jYoBkXPFMz3h4PAilQSWDmMd2MilAKfYumd3fvYxiOhku08FLmf4XVUAzOeK7nuQkG9yXC83AJmPYMMqcBH68nafLMHPGf1K2hi60ter3i2g1f32SnrTqly0F14TJrZCaTKfepp1Ib2LZPG4OE+KEPCN5N9WU1zdWOevl1vIjYB9Q15d84N7CXtW7qk7nJB8IHTlEURl1rPpfoe1I5CTeun8DG0T+Shl+ozUQq2bFOGCoBkR7w9upQFP23eAz0mcPAanIU+TIc+Wuf7AwJJ/1keOmopPZ/euetGY1LCrOOLllh/lwyfOt7nN4JN+qHYw5Vsf5OAgPjXOu03CYB9OUg4Ko1a224XaMzP7H9b92+XnXDX9j/uGieCvDhccqmwCqby35jiTBffwnq27LG/A5lwVJzkk7xafOWNz959w+0nRFL0OnD4LjcQl0gPSI6K8OC4CZIGF885Jx0nqw6UYFdoK0iaB15nCtk+A+EnPHt3Q4i0DZJx8Llb+7MyUy2ufnb05fH9ceX+GoVg0G3iW6fQOvN63LhKePWEXqx5M40C+/6mBwR3UW78Wf/FD1YXxH+sD/1z863LoPfz5neyx+qCw2Ei/qt3bTGzLPeYn668++bYf/emZT9c4f4S/uZt5kJyaTIoFrnb2kQt0HL6Wka4/eqkhMYnekJmBknZXCnlqq1ogLa5aKK5SxcJ37mxounjlUqb+xkSzbUjZZza+2qYWyjXlAp7WVpzpW1uS+uKNOx1UnKvbsnqhy6WbPs279OWDpsUZB16rnW9W1Ustp5hDpxsE+i5uBv9T1iGgf8Oq+TXslZ/wVK//jq8Yl/uSMIUfoLrOsi0zGAtmRlZXIbNcK1ZZWoD/zXjQ/u0gdAEEpydrdWlLNa3unXeybStvTjuc0n+dPDC0RridO9AHkp2sTzm6EWsuy2/Ka44J8OQanmnYeeJS38FK22Ogo4lcMoGb0aevnrt9csLtALuOsjMKipbhqRnpiYKOAjJc21HLMw87mUrmJf7GjDDOzd52PUykrzwWZ4Ga9DC5ihxOppFB1sj0mvCYPIRMlIdQJ0FCHyTsZobp0+HUp85NdU09nm/7fezXIFX/FwZGd5a7OqroPt58xZFJG2kMsRFL1GPxjRg88IXKHDvx9fb7I3cb5J9NWBhN5cHQqyfrwoXGCjyf7JJ8TM61IaD5gZkHyB407VWP16enCz35HFwcPDnpWhPbdr2SytFxHWrXnt30DB057J4+psAh83uHys7BG/+3dUpjOPtEtjnVRqWlKsbsLi3zUCO0kA2QDI4Up1MXLvFor7KHgv9JhliIBb0CdACz4fFkn5l0Cy59I9ktmj4UP8t3AH9+qKMbL34feVnJ+I56HDnGF5vpm3MfSDld+WFKvJ7CFgcsslZyHl+92AG/IxwKPj/X2lBCHtqSPDvFNn+7u5KRK9DDNsfA+IPG8idg0Wl9eajVujQLOT5WAVygy38RGZuLg12kd6GAnLvfoXrrxAkAs4GVix3vAKrK90tHJgDS5kc5v+RxINX/1NArrma1W7ae8hiyHO9qNnYLZCGEdyfvqlA+n78OkGHovyqf+lTJMl6/O24AzC3B5H7OiwmAtJlg3GZMgvzv9QRy1TZT2K0zLNv7Pr8XJ2LSM5OwRBIYB6pfXYNXzk9+Wbw61iV0+JrNEBSMlSLLFjx5pwCfujasNjNMnxli1zLpjz4mhBfLFwq7gj7iX4JW1SHt/tPOVMG7qDTu27dxYB7y72uO3eXLHS1XG4nPIWueO7lO15Zb26815TjujkNENuRGBrbkoFze635SYg6vXIeeA6OBQZzuG554SZ56/OUKCAwuxRTX5GYk1ZQQYAlA/u3f5xTT8OciT5PCzU7x4PKVK43E59A1z508p2vLLZ3X6Dn2uxNAaPXWeB/TaOgPyrmrpFTr3cH4SX3vzoeI+/drGvFT0s3Ac8c2JKQprOmm/Og0Wg4FMMGHSW69/9YLW6QPf1FQIQkrEVP4RnLRh4pof9ulyFTX1ahXNX5dsl9gFJGgrIX4Kdx0YQ21KmqPFAoEYRXHgUvFBM0nR/lXYDRuYwbWBC/8earz2D1ByD/zT4wqWtuqalpaK4zBNB9fBvmnC2s2DHZvuA34oALj4i1omdpzXO0eYqvCsydGn03xdtp0cKMXz7wLaQ58Sm7nrbaZAOLSv4W7/RcUJoTBs8GQf7L/UZhINlKb8Bpcg0mcPS37Q4QEsZ6w1vP6CzwvJZUV5N5CnHQ76Z4NIqtzxwHKdJxKAm6FJAAdt+m8WrDbAQBJh+IEKdSpBBHfg+Nb1R8938INk4xDf5e8DhQTqAgqAoSpVZ4S0vwXRHOxPUnA91Su9WbSBYeRvc9fdgYFvtn9Wv/ekyDKnDVm5PMwvPY66Yp1QOqkVantRd6/eQGL1sEvgZawIOitwdk1/xzWaAaANTEx/pn1h7oRdxGjeWsZA4/px57R+/D5awCT9Dofy2LbgXDANM6+fvePKGNzxKkQrm9ppP7j+yxtHSwehFSPD8XLk5dGij4BZ6dgN+Px8XeJPkyAbGKwBvulzn9kNTt9BzVE3UjtMC+TsDjSkk7dBjjuX7JEv+izUed+ERI/I24JS7OcK7tn379KfXyb3layZxNNUwo4XM1FtDrBkp1WDJwEmgnN/m3MMYaGOtyDpCmvt9baOuAEuACwOG2A6U0uvMtixdJzd3iO72D+vsZrSpt7iC1pZOp7x3c7J8dQpsyTA6SttPYn5deeHWWkUbYBz6hYJGUuBFohwhQFXR7+rfrxF1clJWsA2cQEgUwGc1FJGkNuxJL1WEIjhgBOqy4Dl4fPseQR0q07FBqjECD00Xh0PiUfgyHrMYSmPALYlQoOLyw9Pterbt/4w4m/Pm3fQeDyDQLgQS/DsWFZy0fK0d1HKy8wCUiSBFM4xDMoxj0tkt394r3zrLABrWIvJgMEiS4j0qJLFyX7SpgB9M6nYvj+ZOT8viHd6FuOPXOYSfwlJVm/xtrbsJ+VXf9rsbvpV1ZG4z7Qghpyvzb8fC4gWpMJkEl0VmxA1qeZ/4zou/CBks/pTU8L1CzmmlNKd4Cz0yYXnfkJvwQWHwaAJTFV/HuGZ+Em5+6wDJd9xtdZ5RlZT1enlH8BEjjEr5sfaBQ/ZzJ6YdF2uQ0KR0BPEcRtqjzChadmXeb4w8H2ITBWMGwS/+51ZXsJj1nHzCRff/50m3UevI2ZtGAfcMFlCOHw3jfIM+45OOfx7OIyYfkbPZ9Gj/yJbMDNGYglvf82R5i7CLLLvL13bLf2LoI5nqFT6EdfdMvcmYxOIH4m4EH+6DmZ5Q/nMIxRoHNqk09ezhAPepnC+XYvJyydfE5/6Pj3uFOVcSQQYeTMUf891izdbo/35unObxux4a/g6vXIPwCMn+cPe+eK+suG7U1xd64VR1UkNa1HnFoGlpQuakf6lWVfXFF6MljN6LzZDT4unvqS9+XEFmSg/eDd21c6N7UUHh9dHtJgC12HyqxpghcSC8A1iQQQZ55ooK7+gvU+632CWFHY0rra2Xmr6wAM7XB8yftyavlj7z/HTSDLc6oY/r7XIP5uU77h5WRZYYP5DKRycD3TJPNBB+0BG8TEudMZ6CZlF7bSystGd/r9OsZ3SmjNNSTia+ciQ2nDvqhArHeGs4OpsDLjIb6lUlPmooP0xUrNFka5qsxlGk22tuJBEH15OPTtQqnbwnDo8nxP8Nut+Xm3jf5gEDUKCXa9U4uasXiOmrzjUdmJ85HCSGij8t0+3vnvaeAUTNEXF66cSVJFNlJpkY0JitC4YV8hNDWvMWXO2ipl4a4PmhwBYEbSvHe2MPd2oy84aEGWtVRWyTaVqbU0l6nIXq6qXN8pfnI1H6iTK2pKiomK14i4Cd5Rs4wPOPiLKXzK0gHriC/Tg1hr5QskpMoJEG4LwfkIYyVdwt1eb5+8dzdy5Q4f9XHtvO2BmnxugZqBop0KKqO+0mhyXmPKgpV1yhzLjaamDvteiYtXRDXSqJQzURUHtG+qGivqeyJZQmV9d+RrrwcRU7z1rWoCDzlnrQatqJZyEZYzMwNPWqKqjrcQRVVPR6S3SfitM3ZUO+DwbeZpM6Di9ADnzxFPfeMOGDF9MOStyzeArT3V49ltCEbIHUgC5apQloIH37ATmodhvkFrCZz2V/PhOdnkw6MpppZ+BnFJA3Bs6TE1D3amePENYMeleuibhqCE3EFefqjK1sO6zsDmNOyFFg4xa31e/fSLihb99IZrvV1+AIpOYVezH1ZyPzyTDfxk4leXWbcPQnQhBnCvtLFuaTEa2htN8SVNTaWmlmYtyHfpAqRcmk5o/EG6TYT0oZwb7V5BTzI4UArdcu6dexr6No8Di/eNxDtIEAPLyK8FknHkrH6Ud3im4+XnzoojIpIFLDTYtOpaKaj5HxBMaTgQoy+ApA43UGgE1xGS6hNErp6kIjdLkkQu8QIcIDIWQDe9+kohfpHr6rdACsIl5bQfTfqRzlPc9PEL36F8IyUmvSkIZ7FpR8bOLeacRw6hui8s3vt16ZdP9ztF/w/9XTwz/hlJbvdtCz2zUfGD2696ll9FqvZZ4Hh4mWnPzWSIMyvqd30ZjVVkgZN9aez3z13j3nFR/h5DRTGsIvYnAPtN26nk7Y2KRHxaYsr7bPeS5XX/aiIlMY1ILsPOzJWHF1Bx6ZSid9Urs24VhBxcqpLw7aigz7MR/2YiA3aiKGE2PCDgK+z7FgHXRGzj+z/5hLFFO0rrSqNLnaecydHkOnLsc/VZ4S9AlPC+533/ntEw0Ld6Osp8rp3JG3dtFFkA/kv3dAsmAtaYkKQecml6XYiL7QGPLbU+mQk/h6P+w33Wmpnccdf6a4t/nUX+rTFjGoozCbSgV7pY+biGkuyqfkAZbtCKYXtWuFGOEFZwuHmy3Vr3lNBHPIUVnJIJX4CSg0vJk5owJP+XmE94dF0aQ35YyGS6O4NrNiGrzibqXdjEKHf/y2EtPnfHo3Uf5eWeOebenJiBLyKk2LzcoOiJlLRO/JkQYAGxUcs1AxWlueEro7R8w/s8lotvEyYIA/cLpjXzpV4eh4o9vQ6RPTwXyHy8GAEXhxcIMRiRrFEkAOLJjHRK+nDjcBmljNnIExZPKaSANzs5Pvr5TVXsLCqJJOKKcSeCGgouF8X5udc3FEpXc5sBJ3H3mRGPlImm4Dk4UQ7qxKvqyOiMknD3e2w9ff28eI4XPTodVxfjXS5lRmRy+cSc9uMQa8Ajp5SzDx5ldIHqtyUhC2rUkGFGI2uQQwoj39zAN+BuEPhY4xn0yvnfd6/yQSUAzAawGUlnFlA6lNQzMyDmPkqxh8pPfFkRkIPyfqzJyUiloqweIniQsF+W9+3+YFwIGrjhPleMTBeXjEw2GFUMT5mPTtVVI9+4tBcVmTvcHpWXtRcqLU0QFwDZzJ9zV1woGoKYcddMffp/3r+eGGnvYW96GT0f6VqgVkW9cKCKAssYG4w/SivP+1p4JxrR6mkfvTayE8UcdBLlHyHWz6O+vj6wRBd3uLTPsA+/SiQ1GuXC3z3DnfJ7JuQRM9MouO6zRJ0IHneB5APgKb7zBWZgguPVmabO4Hdvtgc43IXQDlcGZvce9rRVtvkEMKSHJmyk80lNWFJaKlbBXmQgdBEsnIz2XY3+r/CJjdgRFu6T45SE00YhxZ0FACp9M8GZsDnpictRQg50dAL3NMmZ895czNu67HL+tGGopuraa07rgUvJv12bLyU8E95U+w7cS7oYOm+n3jvu+cY4pNpGM3fup0f3VOz0JegRW94DSBvmd33WdCUlPKqSnAaAC3NxcwPF7JvtroiNX9a5LSy9n2OZZlK53Nn/pE8y+3qxdeqNuw1tZlWuwPKAaJXxxHZi/blTdYP2pRYwS+C5sKdHw/KV41TDSAul/H/r738tG5r6PDz3v3tyh5twom8kuOPpTRVFtmLl+RNMEBl8A9XROkYqCDdWpu4pwz5QXDQoM/TzAF2QrHdPpfXGvC3pwSQG53sLkVE8EeTgq05f+sCxIvTcV0Jq2s947EFKgR98IzGxJjxQ9ovs7P0C/defJCXbDcjdP8lxt+39aILBG1ejl5uiSBMGDgerxhuzGmYSYgr/DQE5kz72IhK9gF50nEuyDQh4vCbTK9nPS7eHpnmWm+cAHvBtnvTFXRF1RPG6/HCKnolUwJFJeIB19ShNgdSIJemxxEYMEVysFrfqD3Vw6MO0REYMRUa8tcxgMLMyWXQbk52VTeeAYkWpNr2aL8t451i4jqReV12j1o0VRd4Dueoe5BSh8C9L8Z5XNsWNrvkY/W9fuAh2nNB7XSbkWS08jsUkEFvNalbMnK5JTJw0Jr4psCcr3bgJp8Ld6C4IGLbwVa5hrpaiFuIwsQPUdn9kfqRT6U70IjqRSewu6nbqBuuWTUVNIKclMbmhKbnQJNwsnIJrmJDtWd+UVGSGNcZS524DsrDNVICejBMp6QaJtXT8YcsZ2yIjvcxeOKVpW5+T4ZscprpKRUg4Xl4kJlJmgC0a0pFScpuyEIQNNIKn+Knj3AfS+cSmOZyEpnw8OmyPb4sX+GmEsWDuncFl0RbzRVNFpk+mx/f68BeJxcqnlhyCZSmXlb5tuzWK1fldl7t/mYLw+0sg9S11X/kwjZNRvv6eUH76p2rKZt0pTyBuql2+XG3z/Dq4UEo7TysE0r1dJkCShOhejwlQhi1Awa338kf2/cKvhKttF67ar+a+L/xweRkNKNZfUqgUUHNv40vRjy/yaA9wNjOLrUEMVD8/RuBPbkYe2+DjTvNulv7cjN+EeAHKufxYaM9Lz2MdQNJ+VcI+RFy/ae/fgPTpqvuZHjQ0cru67/pZW/uneS7m43U/mS8k3dvq/+KDRz7ebUy6zlvWNZvzwnxP3e8hkOBVXdNYoagYBJ+9d+FYF0DUMTrHqlSeBoceeK/Q/xOgpPc1RhS1lFDDS4dNNcOl467x424+Y480w89YaIdLoVrJD2UIEMjjRCUtFcTw4rzpw0jFmGs8eODmO/ZIK3zpkWG0EvIw6aEsEajduG6cfcoZ33C3jSZWwPexSr7wgjO+Z3mmSjWfbwtc+sU4moZr++ht17ab4O1BWzxXZn3kXEM0y0MCcPKQwNY7SSxUKnU27EYQ+Mq3+rSg5r+nDaergWhg8rjxaDtHEYlRwCg+jpZsO28kZtoRJiBvG45S0yf8veOlZy8Ut1wMzDSaIrYwKQVSPgZLQqdhCZg9QHgs+cLkTciDKFNs/66mP9TesQ9jZdUX4ehAT7m3VukMZnYGk56VRWdl5dDZc3k1cx9fudiOvCWyDrXZKIOlB9jXpTmXv+fhyS8K+fJeVQYQWLwfl+Skp9FQVjeRlMm7w7WryJ08/piuuMbRztkmWyGk9e+pc5yrPehAjLH4FIZ/1/UsJDcVNBUe47rRei5RsrJHSp6EGdpJ6HQMfr2SfPzjG3uYoBKm90LsnpVVSr8dHbLlMJGxkLAez15Iaho7i46hb7QeNn1k61BHOhYPLOU996Lo4k41tXpgYOxBQ8UTsOS0sbyItS7OQPS2Fe4+/hOIBkFOwc7Se5DDcxigeAOmpW0nAPdlYiPJNxLvKEEItJC9BYf5KJ0uPnNRrI4E72nfy7E3OptnCI9z3WMnz+nqcktHPqjIpuxI/5YslNuLPeEeGlm+DjuPhj+qFNL8r1SEOyrhldYOMymAVPnLUUhhFDAKPdJwU5tQPFsnYCJ6czg8NbMfeT5/6dmL+90ikrilUs7uPeVAY4kB4qPre297IATzkJs+AuvVhtjvCUEPzT+uaGuj1bTewI/MJWHN/84bJ0931qBJV+EujkISg9wugy908c0fmi/MY5bbZfdF0tFU4XTIT/TpA3H6AhiAsU89LqStioi+4+gKDngz+kb/vvhxp7RG8qjQkzbFtpfCVsGvuIKgKKum7HkPZ93GV2L0xZ5Cop84isj0AnrHXGhaWexM9OWBTx/e4boROQQk8BB9EDjcyxf4LpFVw9ZkC7N3InRAgACpyCdjMBgJVFYNX/Nc1ATaoo63UriDY1+429Z0ZlZWOYOVnU2jU75HyWrbjnDENBQQoSMjTgah99MKrrZubWd1txetTCQVfmrNnKZaoQJrSqjj7+b+LUP0iz4Tef4nIWmC15bpdFwZr9Me32K0aSvXcOVZnnTNCrKrVf6fPawljPPxIW84SdehZxyFJDqp94eV8uLbnrQWmDw20GVNgW8D8ldXgZh7tzmCibPoOFoSDoxelX7GGCumvz2YN05HpUWVLgXBJoOPuMXDr8VwJTeVvvBBwADk3gESf+asNCwMX/ukdz4dc/5PBuGPlHSTT3n4dDG6t6A+LTu9Yb/9zh8UhiWveY7Y0+7DsjVzjDjSB4pAhqeEKW63adoWhECrpb/E4dQlhe169kMpBRImf8iIdBPXaxMysLm7Rp49zCT4OaIEc9FuazNFDuVR5w/Scz0so/kL0a+WV0mDFtMv34XAPVVFBPua9st7+y39gp/A+x9m1v9gzliLLX322dNMy8O0IUYHa4crahvMuRjbeMPBtX4wZEf4hSiOYk0dVAHzUidcJXHBCVEAs972g/EL2Fd0Y1ULdfIQRlUmNUdPLucdeJSxjNw/GSSzJDD9Akan5RZRd2EVqhbzLfhB21+Zi++K6nBMUrABLa4WwJd8myYpYA3y2JlKtJYval2CwGcYVSFe6TG1cp1+kSEsqjTiNQhdHpoIcQGLVkf9DaCJkbCIOdWfOhxKQEQern6bnxnKBRCH8OyCmqdZIa772dCnyN8WNq/xWqGC8JnmhAisnVvQZ3b9EWxP0uy4NuWRHDdFrluKwmhOvQg2aU7MDj2S46fIdUuoIB3rO0+AjsXK5EYyBKJBvjl48CcAua9TagxvFJeIk+UyKLDPrNr97wujC+oCOJIDxsW/Q/9q5CynDbNOXD2FnsMRU+q53Oky8bK4I9xmoFduQFjG8qGiSPwTb+MTDzwLJQHOYLaNxcITgyaakJzoewoiKjsqJCI7/WNNZKgxL0zPZe6KEM67EK9mvSSTR5IwPZ5CPdHhhTap4VhRkl03DrVyUoSJI2VWg3E2xjBvpr2KLTNF6gFVIJQwNMCatJ2jtGzuCKHodRwyPsY/zw6lf6wSIGdfznzIm+TEYQER/GfYTOlhRRbVIs97aTHwL9NBGa1y59/NRGhfm8WDEybHZoPjn9/UlFX6reSbHZhG4qgPwHYjxTI/fQVGylSBeY4l7r+nS15cAVnxWr1KjXGThfEGiCYFRJNvO/e7vsRaN7glv0H16ki8/k9tNd5SxX8aIF+WL28YzVkJ0iNGP5cj72DzJzHmVqHAtbWOl4LUDOtoBM9kjiZ02EdPYo4mZGbYDqYBRuLOhc3ZcNZDo/Ff4f7/t0CavgOIP5p2P/7If3o9OeVIrg0J5CIP+ShFMUrQjX70oBd9GMBgGhIagzH1PI+nPdz9jdr9/MuS9nJWYsHzItCB58if0J729RTTEmwe5G1yI6fueoffjzXP+0L7+CdJhwB5frUHLJiK0Y0BIJiS/x/NfgOKmHUW7Sw/1onZrs+qYeEl0lwO9hcAsnxO+u//w8B0wBEmrgeJ9Ly0ZwfAJCDaG6JYW7RozaL39zq1g2zPX79Pzj9A1Q+4kPCWmrBEDbq54xxio4c4n2rLPrhQwLcrWl52XPGW6pr7Lz9yBc7ONuq+MsvHakVBOCq4+lul709JLH1PEAg6/6Qs/k+UY8DqOTJjv+Nqlj+7bWDk/tMrPv/8u9ksPNGb5+nzZX160RkQBrfwvd+sJsE79Mice1aEAra7Q81WCaxR7FNKlaUg5j9/QqXnlyyNFBM7XQTARwQoO2mkupcGQGzEy9AOOPWm+GX+uUz/mQk86bTsfTn28BcesG1B3QcEN6z7p/rA7rbu062cnfu92ZDv36V3/mN/m7+nKTnz9tpHbk2tZWedBsrRBCB+GtU8AbyzLZQC4M60IESvCUD0BxyLzrtg9l1GEfOHa8OEds1p9ez97Vg1n2bKPEu9Ma1E/f79wqgdzEQJN+bZs/Xqns1Y2eVadnmVeXUEd47VoCeF/t057ccKouQAUZ1yojD5m3uJ3c2fb+aq0G2otkR7599C8F8ve+iiOvsmVP/5SFfsSzSXaq8UgNhRhJvfrkyqsX0yuvFiLl3Su0ZdFeP3nyLH0nX+a4ZzyW2z2VJKFfeRCCD2BRGg7PjmOfLDvCWdfY1gr5zoMJ3bN4bPTywgRM5B6BHTOs0ALvicr2wC8G625N8PWnwMdDFLwPXYi603HnKIuWgifLDbwqd9XrXA2o2qrwyWm8ZnjcJnmioPErV6qkk9n+fOucHxGayOvqjp2ey20ybuWezfjjoor4Z/I8bPpZmN+ovg8z/+IvaD7y7Mq+pPX/d57TZMXXcGkXgRB8HX2RYuvC+Bc7F7zF7yj4jCaa/v1kr7mRTzv86wZa844uvCsSOPXcYPcCeCiJXB4mipp75F/bVfSJ2Hwn5o/2/8nJyIi4g3etxO4HSn/66cP0AAuAXu/ZO/+yDyv1hYI3EAvPMljH2E8wq/ksdIn+91gFdEgQHNAvjfi2kpyQ0xhrDrs6Rpsf0h+1el94xuzND8T3Dy2pNvXNzXilZ6dhSaplcgsR0Yc3kCS3KwG8NufWvaukueT5Phw9b+ExRxbHUZSw6vlr0s6rq2Hp4rzSGW7aa1N0mjo6iOQMQirznMy49t3ueUt/ExstX9ELMe49ixbZSh9axXqXl6801h99ucsi0tp6K5VB4ItVvpUe+hM15UFT07a47Vi4PTRcRXm+Smc7juaF9xyRWenUDY1xZswHNedubXPGqm8GlXpPlAqn+gPzZsncZu2GmaB3a2FlMoISdnp77jm73+dk4VtYDcBli5NfDndYvot5hM32DYADTIOjcSgIZZPtPPEYXbQACEPiAIDBslMSu3ztgp3xsujg8ibGESfoyerhKM6y8CE2eyb3bYYrZ6iIwjo0LdO+iZ3Gre5x+EDNKfx8LEXrkQMazcIdvmk2sOqk8DDCWdXAoklKWUy4IvOwgNiaBv0C9ZR/1qakCNQUv+drOy3nz8DBYXfr9v6A+0IesENOI7LbFWqRyWtSPLIvcUWoOVarJErDE/9qJEXdYoWFkW8GXdtO0eRmlUy/afIZPMZC9p2hWxh+JheI7N1YnUEr0eazVhsIJraxzREelX06BfWcugY3BuzY1yS3d9od5aT4jvy0KoVlWAbX4Xscz75GAoHQlSvV6LzgZgGCMFf+AtZjOCTmqeHR26K775pWARdZUndfkTZAxamlnMRekTATscTCye56RwjUTutUBgQqSijVA2i68z0OM8T7FGoocY9BeFXSGl76m7Tpk3swRmD/pMwc6Kl59zpX9VWgHr1zFPurnTP5Cf2Roa3/pMoqetuNVTiJkvnAhNY0IxFrLmgaypIXD+Qa1/csWx4z8amrR2qEqJMz8e5iGNPg6qT1PsZb7DxqGmcZhTRrqNY/HLKycb7e9kpYTDeWFqOo7JJdxzFmX2D7JGUP+wpcXnjJTYuWvLXWz2D9LbXNRe938mjqEaJ5Sa2mKjOCU9vnZ6N9h5TtDfTwOwdH2PfUSfYztCko0DoqWBh2jSRG0tynLRpYg6VZQ3Rb6P6Ezxa955pubAORF9XFJMLm67zOSPS9zckpVXvGx5ig+FbQvFgb7r9MI43U/oc7fmkQvE8xuqb0vkR0l5/j9Hsf8XKemgJXvOLf3ruJ+tq4iMcWpC2VWLtw3nVP8lXguT9kZr64nhHvCyHmL4zCg5LGpOu6ttMdPMXN62ohboax7mtHjP9w/m+w//VsS67Gevp+ui59KY2X9SmI2qnX3XlfpHVgtY21qkPpHYk3kvCOvylezG2FDmSpMo7sA53meQ9g/0RkB3oDmvCdpNQIvrP29NRSzGlVHBHmGX5wnqS8H01J6COWmmNtMTqXclvC4HXEGnwjkPnOk6s6KbtllLHhYSxxq5jBJW42xmVBboEzQ4MJ09Gsdu4+TM28MQnbVNTz1Ni/0DnQb0ASAyKGfsUwgE0GIehOQg5HUFTs4flMYFMCAbBbQNOIHQOS8wBAffEdJDZZSExUJPy2wIxkQ8E5x8icJBIylc9sd0j4cnjfBJzxoRsCpLOHKCplZRrkKjKmZGJjX/i85gj7g9D/yv5cZLo9OtEdK8lyBKf3/QpibHqmjYCtzDrVlKxTFerYzeVwoM4oqpr8LKLC6mk1A2ZiPr8WpP0e+xvmYdPR2UmqBRbR/W7JxOAI9DaILVpARLUMLOOWpZ5WrINKuZucWQwjzzmvlCwQz54lqevCRO6jsG+bnaVmKmFjaKiYpeZo3yJOznnjKKb3YEhPIH6ESEuHUzW798TaT0MGpTBjmfIopDRw+tKRY+NSYwSBzrqhwSkBMqqaa6ckFoEPjJfNTxMpjVqrnwRsPLGQVL1NBiZisCxcyxzKnYxvUleRWzIXKHbhPFKuSqMMqJ2eOaGUU/yVnDp9S+FYYqp6zI4+18/DsbyuJLzMJAmKMWG6IoRoxYceKJL5ENdLA+aQpIOgyOQBq7ADq/TOLwBCKJTAFUGp3BZLE5XB72J1N/A/cBoSiMMKBx3SJEihItRqw48RIkSpIMBy+F6utPT9yCIOcpn68ACRkFVaEixaojCTqgdeo1aNSEjqFZi1Zt2nVHyv+F+vRbjrsyhGnYiN4XHDchPgUwgrw493kLFi35ZNmKVWvWbdi0hQN6BEiKCiqhzmlJ8u9Ru9rjTo8UWFQ5yN4YJCCDm6VpOklFLI8JOVDzyYOPiBoLNhg4HLgIICAREpOg0KRk5BS5KkNFQ6voAUpxMzPLu5zYORjFDfd8fUBQSFhEVEyadBkyZcmWIw6PgIiEjIKKho5BQybo8YxPYAN/LiElI6egpFKoyI78DgZQRKHaozYvVHTFVGzFVXwlVGIlFaqSK6VS3a9StRrtKeVBVTrQMYSntDtSpjJcSrnKquzKqdzKcwJGmCYpNmDFyUJMee8Ilewb34mVKkKbeV/J9iOd/CR3//ufRSLYMmkpFQrrXbPmLJqykPcLV0q6tKaym6liD7IM6XblS5KJJB4OXrEeXUpY09J5n5139RrSb8CgTfYeYBpWysEnRo1x9CNnZhZWZWzKVapQpVqtGnXqNWjSqFmrFjMCtekQbMcX9f1bXZ+Wy7SrSU1FOAMbs1ecNz2wZ/vjh+MrIr1aOIy0d+7PCAaVPmdEA5KMMoHCSCEkJCQwMjIyBAWFi3VUXFzPOQ11EWkCuOIwjpMihpCQkMDIyMjglSuEC1+Zc9u/+f2rKzYTpjfvz7QHlTXU16Ms4lnl65M+qDsGVkisrpCzVyTZWC4xHeka/8k/rXhVdHz9trBv87KRFi8/igkWKSnNYQYFBIEhUBjcx95hgvR07BRUVVnZI3ZXX4YbR1nWkCEwLjim+XwqK6VhpZBpwkWiD2dvltWvpQLl94CXAo3ja08mAEAQ2MvSdL3ugcwX7twmfbCVfkPteqTxdvMBxflc6VLWzmhBcBWyw0kGiCJZbkDh/3hi3xyr8jUgCRkXCAmwjcFAYLTglc+q5JVHR7tWJtEUAp/ey0EmYcp2BlwCI6XVXsFCIFCmEJiEEWY27bmqMsVGUVFRoamp2x1oCpmeAq9cC9jGECDKuMBtWLCZ/4mIAqlcjJSUFE5OTo6kpHSpi5JIlJmNDmDmPc+qJJabjMdpNMlX1BNEnQizrhISAiuUkpJCTS3lvQzl6nKqgCxkYqdw4Qum4Rxrush25urFVFRU/U31XmCgpsIela1cvTvpVQrslE7pxC4cMVBbxHt54vQBXgfACl0y0IBG2fjVmuFo0do7UwGAIASs7+MOv/7/gy5zdpz/w3lxPgDt04RnBFW9rslgW0j8IRg+4IMCPgDao+01EJ8rbFd2tcCY0FanWXpEUfNbJmyjvX9r79qrdtc60tZ7hPGgT8/ZHMXKsqpdtc4iQS5Ze0CmHLegKEBJSwo7mkXLsNMUOIOCnvXRw+gUd9/lCU3X7h2J++Ww1V3RnrPIuq0dPjchH1nyub11Z4PFVfBUJ6xgRStZ2SpWtZrVrVGSi2Aa8GJokPv8Qn4sbf5+rp34x5syfsibOgFQLOtICraXrrLsnyZ6KB/8ooB4kXRdblGw0EGVTvMM1J2DBLiwnOFHaRQaxLWgFqygknUph17O/RNlYBVPE0TNLmpGpuT3UtEe70lIB6jIFAAAAA==);
        }

        body {
            font-family: "IRANSansWebFaNum", sans-serif;
        }
    </style>
</head>

<body>
    <div class="container mt-5">
        <h1 class="text-center">کنترل دما و کولر</h1>
        <div class="card mt-3">
            <div class="card-body">
                <h2 id="currentTemp"></h2>
                <p class="fs-4 fw-bold">وضعیت کولر: <span class="badge" id="acState"></span></p>
                <button type="button" class="btn btn-warning fw-bold" id="overrideButton"></button>
            </div>
        </div>

        <div class="card mt-3">
            <div class="card-body">
                <h2>تنظیمات</h2>
                <form id="settempform" class="row">
                    <div class="col-6">
                        <div class="mb-3">
                            <label class="form-label fw-bold fs-5">حداکثر دما</label>
                            <input type="number" step="0.1" class="form-control" id="maxTemp" required>
                        </div>
                    </div>
                    <div class="col-6">
                        <div class="mb-3">
                            <label class="form-label fw-bold fs-5">حداقل دما</label>
                            <input type="number" step="0.1" class="form-control" id="minTemp" required>
                        </div>
                    </div>
                    <div class="col-12 d-flex justify-content-center align-items-center">
                        <button type="submit" class="btn btn-primary fw-bold flex-fill">ذخیره</button>
                    </div>
                </form>
            </div>
        </div>
    </div>
    <script>
        document.addEventListener("DOMContentLoaded", () => {
            const currentTempEl = document.getElementById('currentTemp');
            const maxTempEl = document.getElementById('maxTemp');
            const minTempEl = document.getElementById('minTemp');
            const acStateEl = document.getElementById('acState');
            const overrideButtonEl = document.getElementById('overrideButton');

            fetch('/getdata')
                .then(response => response.json())
                .then(data => {
                    const { currentTemp, tempMax, tempMin, ACState } = data;

                    currentTempEl.innerHTML = `دما : ${currentTemp} درجه سانتی‌گراد`;
                    maxTempEl.value = tempMax;
                    minTempEl.value = tempMin;

                    // Show/Hide Override Button
                    if (currentTemp >= tempMin) {
                        overrideButtonEl.innerHTML = ACState ? "خاموش کردن" : "روشن کردن";
                        overrideButtonEl.classList.remove("d-none");

                        // Add onclick event based on ACState
                        overrideButtonEl.onclick = () => {
                            const url = ACState ? '/turnoff' : '/turnon';
                            fetch(url)
                                .then(res => {
                                    if (!res.ok) throw new Error('درخواست ناموفق بود');
                                    window.location.reload();
                                })
                                .catch(err => {
                                    console.error("خطا در تغییر وضعیت کولر:", err);
                                    window.location.reload();
                                });
                        };
                    } else {
                        overrideButtonEl.classList.add("d-none");
                        overrideButtonEl.onclick = null;
                    }

                    // Set AC State Badge
                    acStateEl.innerHTML = ACState ? "روشن" : "خاموش";
                    acStateEl.classList.remove("text-bg-success", "text-bg-danger");
                    acStateEl.classList.add(ACState ? "text-bg-success" : "text-bg-danger");
                })
                .catch(error => {
                    console.error("خطا در دریافت داده‌ها:", error);
                });
        });

        document.getElementById('settempform').addEventListener('submit', function (e) {
            e.preventDefault();

            const tempMin = parseFloat(document.getElementById('minTemp').value);
            const tempMax = parseFloat(document.getElementById('maxTemp').value);

            fetch('/settemps', {
                method: 'POST',
                headers: {
                    'Content-Type': 'application/json'
                },
                body: JSON.stringify({ tempMin, tempMax })
            })
                .then(response => {
                    if (!response.ok) throw new Error('خطا در ارسال اطلاعات');
                    return response.json();
                })
                .then(result => {
                    window.location.reload();
                })
                .catch(error => {
                    console.error("خطا:", error);
                    window.location.reload();
                });
        });

    </script>
</body>

</html>
)rawliteral";

AsyncWebServer server(80);

// GPIO pins
const int output = 4;       // AC control pin
const int oneWireBus = 18;  // DS18B20 data pin

OneWire oneWire(oneWireBus);
DallasTemperature sensors(&oneWire);

// Function declarations
void connectToWiFi();

void connectToWiFi() {
  if (WiFi.status() == WL_CONNECTED) return;

  WiFi.disconnect();
  delay(100);
  WiFi.config(local_IP, gateway, subnet);
  WiFi.begin(ssid, password);

  Serial.print("Connecting to WiFi");
  unsigned long startAttemptTime = millis();

  while (WiFi.status() != WL_CONNECTED && millis() - startAttemptTime < 10000) {
    delay(500);
    Serial.print(".");
  }

  if (WiFi.status() == WL_CONNECTED) {
    Serial.println("\nConnected! IP: " + WiFi.localIP().toString());
  } else {
    Serial.println("\nFailed to connect - will retry later");
  }
}

void setup() {
  // Initialize Serail
  Serial.begin(115200);
  delay(1000);

  // Initialize Pin Modes
  pinMode(output, OUTPUT);
  digitalWrite(output, LOW);
  sensors.begin();

  // Connect to WiFi
  connectToWiFi();

  // Initial temperature reading and Set AC Power ON or OFF
  sensors.requestTemperatures();
  lastTemperature = String(sensors.getTempCByIndex(0), 1);
  acState = (lastTemperature.toFloat() > maxTempInput.toFloat());
  digitalWrite(output, acState ? HIGH : LOW);

  // Web server routes
  server.on("/", HTTP_GET, [](AsyncWebServerRequest *request) {
    request->send_P(200, "text/html", index_html);
  });

  server.on("/getdata", HTTP_GET, [](AsyncWebServerRequest *request) {
    // Create a JSON object
    DynamicJsonDocument doc(256);
    doc["tempMin"] = minTempInput;
    doc["tempMax"] = maxTempInput;
    doc["ACState"] = acState;
    doc["currentTemp"] = lastTemperature;

    // Convert JSON object to string
    String jsonString;
    serializeJson(doc, jsonString);

    // Send response
    request->send(200, "application/json", jsonString);
  });

  server.on(
    "/settemps", HTTP_POST, [](AsyncWebServerRequest *request) {},
    NULL,
    [](AsyncWebServerRequest *request, uint8_t *data, size_t len, size_t index, size_t total) {
      // Deserialize JSON
      DynamicJsonDocument doc(256);
      DeserializationError error = deserializeJson(doc, data, len);

      if (error) {
        request->send(400, "application/json", "{\"error\":\"Invalid JSON\"}");
        return;
      }

      // Extract values
      if (doc.containsKey("tempMin") && doc.containsKey("tempMax")) {
        String tempMin = doc["tempMin"].as<String>();
        String tempMax = doc["tempMax"].as<String>();

        // Update global values
        minTempInput = tempMin;
        maxTempInput = tempMax;

        Serial.println("Updated Min/Max Temp: " + minTempInput + " / " + maxTempInput);

        request->send(200, "application/json", "{\"status\":\"success\"}");
      } else {
        request->send(400, "application/json", "{\"error\":\"Missing fields\"}");
      }
    });

  server.on("/turnon", HTTP_GET, [](AsyncWebServerRequest *request) {
    acState = true;
    // manualOverride = true;
    digitalWrite(output, HIGH);
  });

  server.on("/turnoff", HTTP_GET, [](AsyncWebServerRequest *request) {
    acState = false;
    // manualOverride = true;
    digitalWrite(output, LOW);
  });

  ArduinoOTA.begin();

  ArduinoOTA.onStart([]() {
    Serial.println("OTA Starts");
  });
  ArduinoOTA.onEnd([]() {
    Serial.println("OTA Ends");
  });
  ArduinoOTA.onProgress([](unsigned int progress, unsigned int total) {
    // Nothing
  });

  server.begin();
}

void loop() {
  static unsigned long lastTempCheck = 0;
  static unsigned long lastWifiAttempt = 0;

  // Temperature control (works offline)
  if (millis() - lastTempCheck >= 5000) {
    lastTempCheck = millis();
    sensors.requestTemperatures();
    lastTemperature = String(sensors.getTempCByIndex(0), 1);

    float temp = lastTemperature.toFloat();
    if (temp >= maxTempInput.toFloat() && !acState) {
      acState = true;
      digitalWrite(output, HIGH);
    } else if (temp <= minTempInput.toFloat() && acState) {
      acState = false;
      digitalWrite(output, LOW);
    }
    // if (!manualOverride) {
    //   float temp = lastTemperature.toFloat();
    //   if (temp >= maxTempInput.toFloat() && !acState) {
    //     acState = true;
    //     digitalWrite(output, HIGH);
    //   } else if (temp <= minTempInput.toFloat() && acState) {
    //     acState = false;
    //     digitalWrite(output, LOW);
    //   }
    // } else {
    //   if (lastTemperature.toFloat() >= maxTempInput.toFloat() || lastTemperature.toFloat() <= minTempInput.toFloat()) {
    //     manualOverride = false;
    //   }
    // }
  }

  // WiFi maintenance (tries every 30 seconds)
  if (millis() - lastWifiAttempt >= 30000) {
    lastWifiAttempt = millis();
    connectToWiFi();
  }

  // Handle OTA if connected
  if (WiFi.status() == WL_CONNECTED) {
    ArduinoOTA.handle();
  }

  delay(10);
}